## configs/rk3562_evb_defconfig
```kconfig
BR2_aarch64=y
BR2_TOOLCHAIN_EXTERNAL=y
BR2_TARGET_GENERIC_HOSTNAME="rk3562_evb"
BR2_TARGET_GENERIC_ISSUE="Welcome to the rock5b board"
BR2_SYSTEM_DHCP="eth0"
BR2_PACKAGE_ROCKCHIP_RKBIN=y
BR2_PACKAGE_ROCKCHIP_RKBIN_TPL_FILENAME="bin/rk35/rk3588_ddr_lp4_2112MHz_lp5_2736MHz_v1.12.bin"
BR2_PACKAGE_ROCKCHIP_RKBIN_BL31_FILENAME="bin/rk35/rk3588_bl31_v1.40.elf"
BR2_TARGET_ROOTFS_EXT2=y
BR2_TARGET_ROOTFS_EXT2_4=y
BR2_TARGET_ROOTFS_EXT2_SIZE="250M"
BR2_TARGET_UBOOT=y
BR2_TARGET_UBOOT_BUILD_SYSTEM_KCONFIG=y
BR2_TARGET_UBOOT_CUSTOM_GIT=y
BR2_TARGET_UBOOT_CUSTOM_REPO_URL="https://github.com/Benetti-Engineering-sas/rockchip-u-boot.git"
BR2_TARGET_UBOOT_CUSTOM_REPO_VERSION="1e88ce5a983ddbc8e16eab3e100d811058b3677e"
BR2_TARGET_UBOOT_BOARD_DEFCONFIG="rk3562"
BR2_TARGET_UBOOT_NEEDS_PYLIBFDT=y
BR2_TARGET_UBOOT_NEEDS_PYELFTOOLS=y
BR2_TARGET_UBOOT_NEEDS_OPENSSL=y
BR2_PACKAGE_HOST_DOSFSTOOLS=y
BR2_PACKAGE_HOST_GENIMAGE=y
BR2_PACKAGE_HOST_KMOD=y
BR2_PACKAGE_HOST_MTOOLS=y
BR2_PACKAGE_HOST_UBOOT_TOOLS=y
BR2_PACKAGE_HOST_UBOOT_TOOLS_FIT_SUPPORT=y
```

## configs/rockchip_px30_mini_evb_defconfig
```kconfig
BR2_aarch64=y
BR2_cortex_a35=y
BR2_TARGET_GENERIC_HOSTNAME="px30-evb"
BR2_TARGET_GENERIC_ISSUE="Welcome to Rockchip PX30 Mini EVB"
BR2_SYSTEM_ENABLE_NLS=y
BR2_ROOTFS_POST_BUILD_SCRIPT="board/rockchip/px30-mini-evb/post-build.sh"
BR2_ROOTFS_POST_IMAGE_SCRIPT="support/scripts/genimage.sh"
BR2_ROOTFS_POST_SCRIPT_ARGS="-c board/rockchip/px30-mini-evb/genimage.cfg"
BR2_LINUX_KERNEL=y
BR2_LINUX_KERNEL_CUSTOM_VERSION=y
BR2_LINUX_KERNEL_CUSTOM_VERSION_VALUE="6.1.19"
BR2_LINUX_KERNEL_USE_ARCH_DEFAULT_CONFIG=y
BR2_LINUX_KERNEL_DTS_SUPPORT=y
BR2_LINUX_KERNEL_INTREE_DTS_NAME="rockchip/px30-evb"
BR2_LINUX_KERNEL_NEEDS_HOST_OPENSSL=y
BR2_TARGET_ROOTFS_EXT2=y
BR2_TARGET_ROOTFS_EXT2_4=y
BR2_TARGET_ROOTFS_EXT2_SIZE="240M"
BR2_TARGET_ARM_TRUSTED_FIRMWARE=y
BR2_TARGET_ARM_TRUSTED_FIRMWARE_CUSTOM_VERSION=y
BR2_TARGET_ARM_TRUSTED_FIRMWARE_CUSTOM_VERSION_VALUE="v2.8"
BR2_TARGET_ARM_TRUSTED_FIRMWARE_PLATFORM="px30"
BR2_TARGET_ARM_TRUSTED_FIRMWARE_IMAGES=""
BR2_TARGET_ARM_TRUSTED_FIRMWARE_NEEDS_ARM32_TOOLCHAIN=y
BR2_TARGET_UBOOT=y
BR2_TARGET_UBOOT_BUILD_SYSTEM_KCONFIG=y
BR2_TARGET_UBOOT_CUSTOM_VERSION=y
BR2_TARGET_UBOOT_CUSTOM_VERSION_VALUE="2023.10"
BR2_TARGET_UBOOT_BOARD_DEFCONFIG="evb-px30"
BR2_TARGET_UBOOT_NEEDS_DTC=y
BR2_TARGET_UBOOT_NEEDS_PYLIBFDT=y
BR2_TARGET_UBOOT_NEEDS_PYELFTOOLS=y
BR2_TARGET_UBOOT_NEEDS_OPENSSL=y
BR2_TARGET_UBOOT_NEEDS_ATF_BL31=y
BR2_TARGET_UBOOT_NEEDS_ATF_BL31_ELF=y
BR2_TARGET_UBOOT_FORMAT_CUSTOM=y
BR2_TARGET_UBOOT_FORMAT_CUSTOM_NAME="u-boot-rockchip.bin"
BR2_PACKAGE_HOST_DOSFSTOOLS=y
BR2_PACKAGE_HOST_GENIMAGE=y
BR2_PACKAGE_HOST_MTOOLS=y
BR2_PACKAGE_HOST_UBOOT_TOOLS=y
```

## package/dotnet-runtime-prebuilt/Config.in
```kconfig
config BR2_PACKAGE_DOTNET_RUNTIME_PREBUILT_ARCH_SUPPORTS
	bool
	default y if BR2_aarch64
	default y if (BR2_arm && BR2_ARM_EABIHF)
	default y if BR2_x86_64
	depends on BR2_USE_MMU # fork()

config BR2_PACKAGE_DOTNET_RUNTIME_PREBUILT
	bool "dotnet-runtime-prebuilt"
	depends on BR2_TOOLCHAIN_USES_GLIBC || BR2_TOOLCHAIN_USES_MUSL
	depends on BR2_TOOLCHAIN_HAS_THREADS
	depends on BR2_INSTALL_LIBSTDCPP
	depends on !BR2_STATIC_LIBS
	depends on BR2_PACKAGE_DOTNET_RUNTIME_PREBUILT_ARCH_SUPPORTS
	select BR2_PACKAGE_HOST_CMAKE
	select BR2_PACKAGE_ICU
	select BR2_PACKAGE_LIBCURL
	select BR2_PACKAGE_LIBKRB5
	select BR2_PACKAGE_LIBZLIB
	select BR2_PACKAGE_OPENSSL
	help
	  .NET Core 8 Runtime Prebuilt

	  https://dotnet.microsoft.com/download/dotnet-core/8.0

comment "dotnet-runtime needs a toolchain w/ glibc or musl and threads"
	depends on BR2_PACKAGE_DOTNET8_RUNTIME_PREBUILT_ARCH_SUPPORTS
	depends on !BR2_TOOLCHAIN_USES_GLIBC && !BR2_TOOLCHAIN_USES_MUSL
	depends on BR2_STATIC_LIBS || !BR2_TOOLCHAIN_HAS_THREADS
```

## package/dotnet8-runtime/Config.in
```kconfig
config BR2_PACKAGE_DOTNET8_RUNTIME_ARCH_SUPPORTS
	bool
	default y if BR2_aarch64
	# On ARM CoreCLR JIT requires 16 64-bit or 32 32-bit FPU registers
	default y if BR2_arm && (BR2_ARM_FPU_VFPV3 || BR2_ARM_FPU_VFPV3D16 || \
				 BR2_ARM_FPU_VFPV4 || BR2_ARM_FPU_VFPV4D16)
	depends on BR2_USE_MMU # fork()
	depends on BR2_TOOLCHAIN_GCC_AT_LEAST_8 # aarch64 fpu assembly registers build failure

config BR2_PACKAGE_DOTNET8_RUNTIME
	bool "dotnet8-runtime"
	depends on BR2_TOOLCHAIN_USES_GLIBC || BR2_TOOLCHAIN_USES_MUSL
	depends on BR2_TOOLCHAIN_HAS_THREADS
	depends on !BR2_STATIC_LIBS
	depends on BR2_INSTALL_LIBSTDCPP
	depends on BR2_PACKAGE_DOTNET8_RUNTIME_ARCH_SUPPORTS
	select BR2_PACKAGE_HOST_CMAKE
	select BR2_PACKAGE_ICU
	select BR2_PACKAGE_LIBCURL
	select BR2_PACKAGE_LIBKRB5
	select BR2_PACKAGE_LIBZLIB
	select BR2_PACKAGE_LTTNG_LIBUST
	select BR2_PACKAGE_OPENSSL
	help
	  .NET Core 8 Runtime

	  https://dotnet.microsoft.com/download/dotnet-core/8.0

comment "dotnet-runtime needs a toolchain w/ glibc or musl and threads"
	depends on BR2_PACKAGE_DOTNET8_RUNTIME_ARCH_SUPPORTS
	depends on !BR2_TOOLCHAIN_USES_GLIBC && !BR2_TOOLCHAIN_USES_MUSL
	depends on BR2_STATIC_LIBS || !BR2_TOOLCHAIN_HAS_THREADS
```

## package/libtracefs/Config.in
```kconfig
config BR2_PACKAGE_LIBTRACEFS
	bool "libtracefs"
	select BR2_PACKAGE_LIBTRACEEVENT
	help
	  libtracefs is used to easily interface with the ftrace
	  interface through the tracefs virtual filesystem.
```

## package/mono/Config.in
```kconfig
config BR2_PACKAGE_HOST_MONO_ARCH_SUPPORTS
	bool
	default y if BR2_HOSTARCH = "x86_64"
	default y if BR2_HOSTARCH = "x86"

config BR2_PACKAGE_MONO_ARCH_SUPPORTS
	bool
	default y if (BR2_aarch64 || BR2_arm || BR2_armeb || \
		      BR2_i386 || BR2_powerpc || BR2_x86_64)
	depends on BR2_PACKAGE_HOST_MONO_ARCH_SUPPORTS
	depends on BR2_PACKAGE_LIBATOMIC_OPS_ARCH_SUPPORTS

config BR2_PACKAGE_MONO
	bool "mono"
	depends on BR2_PACKAGE_MONO_ARCH_SUPPORTS
	depends on BR2_INSTALL_LIBSTDCPP
	depends on BR2_TOOLCHAIN_HAS_THREADS_NPTL # pthread_getattr_np()
	depends on !BR2_STATIC_LIBS
	select BR2_PACKAGE_LIBATOMIC_OPS
	help
	  An open source, cross-platform, implementation of C#
	  and the CLR that is binary compatible with Microsoft.NET.

	  http://download.mono-project.com/sources/mono/

config BR2_PACKAGE_MONO_SPECIFY_FOLDERS_TO_INSTALL
	bool "Specify folders to install to target"
	help
	  Allow to specify which Mono folder to install to target

if BR2_PACKAGE_MONO_SPECIFY_FOLDERS_TO_INSTALL

config BR2_PACKAGE_MONO_FOLDERS_TO_INSTALL
	string "Mono folders to install to target"
	help
	  Paths to Mono folders to install to target /usr/lib/mono/.
	  Only these folders will be copied to the target and not all
	  the built ones. You can provide a list of folders separated by
	  by spaces.

endif
comment "mono needs a toolchain w/ C++, NPTL, dynamic library"
	depends on BR2_PACKAGE_MONO_ARCH_SUPPORTS
	depends on !BR2_INSTALL_LIBSTDCPP || \
		!BR2_TOOLCHAIN_HAS_THREADS_NPTL || BR2_STATIC_LIBS
```

## package/qt6/qt6shadertools/Config.in
```kconfig
config BR2_PACKAGE_QT6SHADERTOOLS
	bool "qt6shadertools"
	select BR2_PACKAGE_HOST_QT6BASE
	select BR2_PACKAGE_QT6BASE_GUI
	select BR2_PACKAGE_HOST_QT6BASE_GUI
	help
	  Qt is a cross-platform application and UI framework for
	  developers using C++.

	  The Qt Shader Tools module builds on the SPIR-V Open
	  Source Ecosystem as described at the Khronos SPIR-V web
	  site.

	  https://doc.qt.io/qt-6/qtshadertools-index.html
```
