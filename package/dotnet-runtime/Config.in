## package/dotnet-runtime/Config.in
```kconfig
config BR2_PACKAGE_DOTNET_RUNTIME_ARCH_SUPPORTS
	bool
	default y if BR2_aarch64
	# The official ARM binaries are built for ARMv7-A with the
	# hard-float ABI. The CoreCLR JIT also needs at least a VFPv3-D16
	# FPU.
	default y if BR2_arm && BR2_ARM_EABIHF && \
		(BR2_ARM_CPU_ARMV7A || BR2_ARM_CPU_ARMV8A) && \
		(BR2_ARM_FPU_VFPV3 || BR2_ARM_FPU_VFPV3D16 || \
		BR2_ARM_FPU_VFPV4 || BR2_ARM_FPU_VFPV4D16 || \
		BR2_ARM_FPU_NEON || BR2_ARM_FPU_NEON_VFPV4 || \
		BR2_ARM_FPU_FP_ARMV8 || BR2_ARM_FPU_NEON_FP_ARMV8)
	default y if BR2_x86_64
	depends on BR2_USE_MMU # fork()

config BR2_PACKAGE_DOTNET_RUNTIME
	bool "dotnet-runtime"
	depends on BR2_PACKAGE_DOTNET_RUNTIME_ARCH_SUPPORTS
	depends on !BR2_TOOLCHAIN_USES_UCLIBC
	depends on BR2_INSTALL_LIBSTDCPP
	depends on !BR2_STATIC_LIBS
	help
	  The .NET runtime, needed to execute .NET applications.

	  Applications built for an older .NET version (for example
	  net10.0) only run on this runtime with the Major roll forward
	  policy: RollForward set to Major in their project, or
	  DOTNET_ROLL_FORWARD=Major in their environment.

	  ICU, OpenSSL and libkrb5 are loaded by the runtime only when
	  an application needs them. Use the options below to install
	  the ones needed by your applications.

	  https://docs.microsoft.com/dotnet/core/

if BR2_PACKAGE_DOTNET_RUNTIME

# The pre-built runtime provided by Microsoft is the only provider
config BR2_PACKAGE_DOTNET_RUNTIME_BIN
	bool
	default y
	select BR2_PACKAGE_HAS_DOTNET_RUNTIME

config BR2_PACKAGE_DOTNET_RUNTIME_ICU
	bool "ICU support"
	default y
	depends on BR2_USE_WCHAR # icu
	depends on BR2_TOOLCHAIN_GCC_AT_LEAST_7 # icu
	depends on BR2_HOST_GCC_AT_LEAST_7 # icu
	depends on BR2_TOOLCHAIN_HAS_THREADS # icu
	select BR2_PACKAGE_ICU
	help
	  Install ICU, needed by the globalization features (cultures,
	  string comparison and casing, time zones, ...).

	  Without ICU, applications fail to start, unless they are
	  built with InvariantGlobalization set to true, or run with
	  DOTNET_SYSTEM_GLOBALIZATION_INVARIANT=1.

comment "ICU support needs a toolchain w/ wchar, threads, gcc >= 7, host gcc >= 7"
	depends on !BR2_USE_WCHAR || !BR2_TOOLCHAIN_HAS_THREADS || \
		!BR2_TOOLCHAIN_GCC_AT_LEAST_7 || !BR2_HOST_GCC_AT_LEAST_7

config BR2_PACKAGE_DOTNET_RUNTIME_OPENSSL
	bool "OpenSSL support"
	default y
	select BR2_PACKAGE_OPENSSL
	select BR2_PACKAGE_OPENSSL_FORCE_LIBOPENSSL
	help
	  Install OpenSSL, needed by the cryptography and TLS features
	  (System.Security.Cryptography, SslStream, HTTPS with
	  HttpClient, ...).

config BR2_PACKAGE_DOTNET_RUNTIME_KRB5
	bool "Kerberos support"
	default y
	select BR2_PACKAGE_LIBKRB5
	help
	  Install the MIT Kerberos GSSAPI library (libgssapi_krb5),
	  needed by the Kerberos (Negotiate) authentication
	  (NegotiateStream, HttpClient with default credentials, ...).

	  NTLM authentication also needs the gss-ntlmssp plugin, which
	  is not available in Buildroot.

config BR2_PACKAGE_HAS_DOTNET_RUNTIME
	bool

config BR2_PACKAGE_PROVIDES_DOTNET_RUNTIME
	string
	default "dotnet-runtime-bin" if BR2_PACKAGE_DOTNET_RUNTIME_BIN

endif

comment "dotnet-runtime needs a glibc or musl toolchain w/ C++, dynamic library"
	depends on BR2_PACKAGE_DOTNET_RUNTIME_ARCH_SUPPORTS
	depends on BR2_TOOLCHAIN_USES_UCLIBC || !BR2_INSTALL_LIBSTDCPP || \
		BR2_STATIC_LIBS
```

## support/testing/tests/package/br2-external/libfuse3/package/libfuse3-test/Config.in
```kconfig
config BR2_PACKAGE_LIBFUSE3_TEST
	bool "libfuse3-test"
	depends on BR2_PACKAGE_LIBFUSE3
	help
	  Test program for the libfuse3 library.
```

## support/testing/tests/package/br2-external/libnspr/package/libnspr-test/Config.in
```kconfig
config BR2_PACKAGE_LIBNSPR_TEST
	bool "libnspr-test"
	depends on BR2_PACKAGE_LIBNSPR
	help
	  Test program for the NSPR library.
```

## support/testing/tests/package/br2-external/mongoose/package/mongoose-test/Config.in
```kconfig
config BR2_PACKAGE_MONGOOSE_TEST
	bool "mongoose-test"
	depends on BR2_PACKAGE_MONGOOSE
	help
	  Test program for the mongoose library.
```

## support/testing/tests/package/br2-external/zlib-ng/package/zlib-ng-test/Config.in
```kconfig
config BR2_PACKAGE_ZLIB_NG_TEST
	bool "zlib-ng-test"
	depends on BR2_PACKAGE_ZLIB_NG
	help
	  Test program for the zlib-ng library.
```
